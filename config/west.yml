## config/west.yml
```yaml
manifest:
  remotes:
    - name: zmkfirmware
      url-base: https://github.com/zmkfirmware
    - name: badjeff
      url-base: https://github.com/badjeff
  projects:
    - name: zmk
      remote: zmkfirmware
      revision: 24487bd9744f504724089f0e1cec98431a2d3333
      import: app/west.yml
    - name: zmk-behavior-mouse-key-toggle
      remote: badjeff
      revision: 4ad25024
  self:
    path: config
```
